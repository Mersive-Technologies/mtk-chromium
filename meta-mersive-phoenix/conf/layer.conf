## meta-mersive-phoenix/conf/layer.conf
```bitbake
BBPATH .= ":${LAYERDIR}"

BBFILES += "${LAYERDIR}/recipes-*/*/*.bb \
            ${LAYERDIR}/recipes-*/*/*.bbappend"

BBFILE_COLLECTIONS += "meta-mersive-phoenix"
BBFILE_PATTERN_meta-mersive-phoenix = "^${LAYERDIR}/"
BBFILE_PRIORITY_meta-mersive-phoenix = "33"

LAYERDEPENDS_meta-mersive-phoenix = "chromium-browser-layer"
LAYERSERIES_COMPAT_meta-mersive-base = "kirkstone"
```
